## conf/bblayers.conf
```bitbake
# POKY_BBLAYERS_CONF_VERSION is increased each time build/conf/bblayers.conf
# changes incompatibly
POKY_BBLAYERS_CONF_VERSION = "2"

BBPATH = "${TOPDIR}"
BBFILES ?= ""

BBLAYERS ?= " \
  /home/sofar/yocto/poky/meta \
  /home/sofar/yocto/poky/meta-poky \
  /home/sofar/yocto/poky/meta-yocto-bsp \
  /home/sofar/yocto/meta-raspberrypi \
  /home/sofar/yocto/poky/rpi-4-build/meta-custom-sato \
  /home/sofar/yocto/meta-openembedded/meta-filesystems \
  /home/sofar/yocto/meta-openembedded/meta-gnome \
  /home/sofar/yocto/meta-openembedded/meta-initramfs \
  /home/sofar/yocto/meta-openembedded/meta-multimedia \
  /home/sofar/yocto/meta-openembedded/meta-networking \
  /home/sofar/yocto/meta-openembedded/meta-oe \
  /home/sofar/yocto/meta-openembedded/meta-perl \
  /home/sofar/yocto/meta-openembedded/meta-python \
  /home/sofar/yocto/meta-openembedded/meta-webserver \
  /home/sofar/yocto/meta-openembedded/meta-xfce \
  /home/sofar/yocto/meta-qt5 \
  "
```

## meta-custom-sato/conf/layer.conf
```bitbake
# We have a conf and classes directory, add to BBPATH
BBPATH .= ":${LAYERDIR}"

# We have recipes-* directories, add to BBFILES
BBFILES += "${LAYERDIR}/recipes-*/*/*.bb \
            ${LAYERDIR}/recipes-*/*/*.bbappend"

BBFILE_COLLECTIONS += "meta-custom-sato"
BBFILE_PATTERN_meta-custom-sato = "^${LAYERDIR}/"
BBFILE_PRIORITY_meta-custom-sato = "6"

LAYERDEPENDS_meta-custom-sato = "core"
LAYERSERIES_COMPAT_meta-custom-sato = "kirkstone"
```
